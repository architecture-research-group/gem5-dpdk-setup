## buildroot/Config.in
```kconfig
source "$BR2_EXTERNAL_DPDK_GEM5_PATH/package/dpdk/Config.in"
source "$BR2_EXTERNAL_DPDK_GEM5_PATH/package/dpdk_memcached/Config.in"
```

## buildroot/package/dpdk_memcached/Config.in
```kconfig
config BR2_PACKAGE_DPDK_MEMCACHED
	bool "dpdk_memcached"
	depends on BR2_TOOLCHAIN_HAS_THREADS
	depends on BR2_USE_MMU # fork()
	depends on BR2_PACKAGE_GFLAGS
	select BR2_PACKAGE_LIBEVENT
	help
		dpdk_memcached for gem5
```

## buildroot/package/dpdk_pktgen/Config.in
```kconfig
config BR2_PACKAGE_DPDK_PKTGEN
	bool "dpdk_pktgen"
	depends on BR2_TOOLCHAIN_HEADERS_AT_LEAST_5_15
	depends on BR2_PACKAGE_DPDK
	select BR2_PACKAGE_UTIL_LINUX_BINARIES
	help
		dpdk_pktgen for gem5
```
